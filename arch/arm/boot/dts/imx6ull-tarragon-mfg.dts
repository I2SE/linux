/*
 * Copyright (C) 2018 I2SE GmbH
 * Copyright (C) 2020 in-tech smart charging GmbH
 *
 * This program is free software; you can redistribute it and/or modify
 * it under the terms of the GNU General Public License version 2 as
 * published by the Free Software Foundation.
 */

#include "imx6ull-tarragon-common.dtsi"
#include "imx6ull-tarragon-pmic.dtsi"

/ {
	model = "I2SE Tarragon Mfgtool";
	compatible = "fsl,imx6ull-tarragon", "fsl,imx6ull";
};

&iomuxc {
	pinctrl-0 = <&pinctrl_push_pull_cfg>;
};

&iomuxc_snvs {
	pinctrl-0 = <&init_GPIO_pinsSnvs>;
};

&usbotg1 {
	dr_mode = "peripheral";
	status = "okay";
};
